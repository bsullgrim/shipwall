/*
 * shipwall_esp32.ino  --  St. Lawrence Ship Wall display firmware (128x64)
 *
 * Hardware (recommended build):
 *   - Adafruit MatrixPortal S3  (ESP32-S3 + HUB75 connector + level shifter
 *     + PSRAM, all on one board) -- plug the panel ribbon straight in.
 *   - 2x 64x64 HUB75E panels chained = 128x64 logical surface.
 *   - 5V / 8A power supply for the panels (NEVER power them from the board).
 *
 *   Also works on a plain ESP32 / ESP32-Trinity; see PIN CONFIG below.
 *
 * Libraries (Arduino Library Manager):
 *   - ESP32-HUB75-MatrixPanel-DMA  (by mrcodetastic)
 *   - ArduinoJson                  (by Benoit Blanchon)
 *
 * Behaviour:
 *   - Connects to 2.4 GHz WiFi, runs an HTTP server.
 *   - The Pi POSTs a JSON frame to /frame every ~10s carrying vessels,
 *     a sun-based brightness target, and a Seaway-closed flag.
 *   - ADAPTIVE LAYOUT: 1 vessel -> one large card; 2+ -> two-vessel split,
 *     cycling pairs. Brightness obeys the Pi. Idle/closed/waiting screens
 *     cover every other state so the panel is never blank or stale.
 */

#include <WiFi.h>
#include <WebServer.h>
#include <ArduinoJson.h>
#include <ESP32-HUB75-MatrixPanel-DMA.h>
#include "ship_sprites.h"   // generated by make_sprites.py (any SPRITE_SIZE)

// ---- User configuration -----------------------------------------------------
const char* WIFI_SSID = "YOUR_2.4GHz_SSID";
const char* WIFI_PASS = "YOUR_WIFI_PASSWORD";

#define PANEL_W   64        // width of one panel
#define PANEL_H   64        // height of one panel  (64 -> 1/32 scan, needs E)
#define PANEL_N   2         // panels chained -> 128x64 total

const uint32_t PAIR_DWELL_MS = 6000;   // time each vessel/pair stays on screen
const uint32_t DATA_TIMEOUT_MS = 60000;// no frame for this long -> "waiting"

// ---- PIN CONFIG -------------------------------------------------------------
// MatrixPortal S3: leave USE_DEFAULT_PINS = true; the library knows the board.
// Plain ESP32 (classic) with hand-wiring: set false and use the block below.
#define USE_DEFAULT_PINS true

// ---- Globals ----------------------------------------------------------------
MatrixPanel_I2S_DMA* dma = nullptr;
WebServer server(80);

struct Vessel {
  String name;
  String op;          // operator key -> sprite lookup
  String type;
  String dest;
  float  sog;
  int    cog;
  float  drft;
  bool   hasDrft;
  char   dir;         // 'D' down, 'U' up, 'M' moored, '?' unknown
};
const int MAX_V = 5;
Vessel vessels[MAX_V];
int   vesselCount = 0;

struct RosterEntry {
  String name;        // <=8 chars
  String op;
  char   dir;
};
const int MAX_R = 7;
RosterEntry roster[MAX_R];
int   rosterCount = 0;

// Zone split of the 128px width: detail on the left, roster on the right.
const int ROSTER_W = 40;             // right-side roster width
int  DETAIL_W;                       // = W - ROSTER_W, set in setup

int   pairIndex   = 0;        // which vessel (or pair) is showing
uint32_t lastSwap = 0;
uint32_t lastFrameMs = 0;     // when we last heard from the Pi
bool  seawayClosed = false;
uint8_t targetBright = 128;

uint16_t C_NAME, C_LABEL, C_VALUE, C_DIM, C_ACCENT, C_UP, C_DOWN;

int W, H;   // logical width/height, filled in setup

// ---- Drawing helpers --------------------------------------------------------
void drawCentered(const char* text, int y, uint16_t color) {
  int16_t x1, y1; uint16_t w, h;
  dma->setTextSize(1);
  dma->getTextBounds(text, 0, 0, &x1, &y1, &w, &h);
  dma->setTextColor(color);
  dma->setCursor((W - w) / 2, y);
  dma->print(text);
}

// Center text within the left `zoneW` pixels (used for the detail zone).
void drawCenteredIn(const char* text, int zoneW, int y, uint16_t color) {
  int16_t x1, y1; uint16_t w, h;
  dma->setTextSize(1);
  dma->getTextBounds(text, 0, 0, &x1, &y1, &w, &h);
  dma->setTextColor(color);
  dma->setCursor((zoneW - w) / 2, y);
  dma->print(text);
}

// Blit a sprite scaled to `dim` x `dim` at (ox,oy) by nearest-neighbour
// sampling; black (0x0000) is transparent. Pass dim == SPRITE_SIZE for 1:1.
void drawSpriteScaled(const uint16_t* spr, int ox, int oy, int dim) {
  for (int y = 0; y < dim; y++) {
    int sy = y * SPRITE_SIZE / dim;
    for (int x = 0; x < dim; x++) {
      int sx = x * SPRITE_SIZE / dim;
      uint16_t c = pgm_read_word(&spr[sy * SPRITE_SIZE + sx]);
      if (c != 0x0000) dma->drawPixel(ox + x, oy + y, c);
    }
  }
}

const uint16_t* spriteFor(const Vessel& v) {
  char opbuf[16];
  v.op.toCharArray(opbuf, sizeof(opbuf));
  return spriteForKey(opbuf);
}

// Draw a small direction indicator at (x,y) in a 5x5 cell:
//   'D' downbound -> filled down-triangle (toward the sea)
//   'U' upbound   -> filled up-triangle  (toward the lakes)
//   'M' moored    -> small square
//   else          -> dot
void drawDirGlyph(char dir, int x, int y) {
  uint16_t col = (dir == 'D') ? C_DOWN : (dir == 'U') ? C_UP : C_DIM;
  if (dir == 'D') {
    // Point down: wide top row, narrowing to a point at the bottom.
    for (int r = 0; r < 4; r++)
      for (int c = r; c <= 4 - r; c++) dma->drawPixel(x + c, y + r, col);
  } else if (dir == 'U') {
    // Point up: vertical mirror of 'D' -- point at top, wide at the bottom.
    for (int r = 0; r < 4; r++)
      for (int c = r; c <= 4 - r; c++) dma->drawPixel(x + c, y + (3 - r), col);
  } else if (dir == 'M') {
    for (int r = 1; r < 4; r++)
      for (int c = 1; c < 4; c++) dma->drawPixel(x + c, y + r, col);
  } else {
    dma->drawPixel(x + 2, y + 2, col);
  }
}

// Render the right-side roster: one line per ship, dir glyph + name.
// (No mini funnel -- those pixels go to a longer name.)
void printClipped(const String& s, int x, int maxX, uint16_t col);  // fwd decl
void drawRoster() {
  const int rx = DETAIL_W;                 // roster zone left edge
  // vertical divider
  for (int y = 0; y < H; y += 2) dma->drawPixel(rx, y, C_DIM);

  if (rosterCount == 0) return;
  const int rowH = H / MAX_R;              // 64/7 = 9px rows
  dma->setTextSize(1);
  for (int i = 0; i < rosterCount && i < MAX_R; i++) {
    int y = i * rowH;
    int x = rx + 2;
    drawDirGlyph(roster[i].dir, x, y + (rowH - 5) / 2);
    dma->setCursor(x + 7, y + (rowH - 7) / 2);
    printClipped(roster[i].name, x + 7, W, C_VALUE);  // stop at panel edge
  }
}

// Draw one vessel within a band whose top is `top` and height is `bandH`.
// `big` selects the spacious single-vessel layout vs. the compact split row.
// Print `s` at the current cursor but clip to at most `maxX` (exclusive),
// so detail-zone text never crosses into the roster. 6px per glyph.
void printClipped(const String& s, int x, int maxX, uint16_t col) {
  int maxChars = (maxX - x) / 6;
  if (maxChars < 1) return;
  dma->setTextColor(col);
  dma->setCursor(x, dma->getCursorY());
  if ((int)s.length() <= maxChars) dma->print(s);
  else dma->print(s.substring(0, maxChars));
}

void drawVesselBand(const Vessel& v, int top, int bandH, bool big) {
  dma->setTextSize(1);
  const int edge = DETAIL_W - 1;                  // text must stop before divider

  if (big) {
    // Big card: name across the top, then a large funnel lower-left with the
    // metrics stacked to its right -- the FlightWall "logo is prominent" look.
    dma->setCursor(1, top + 1);
    printClipped(v.name, 1, edge - 5, C_NAME);    // leave room for dir glyph
    int dirX = 1 + min((int)v.name.length(), (edge - 5 - 1) / 6) * 6 + 2;
    if (dirX < edge - 4) drawDirGlyph(v.dir, dirX, top + 1);

    // Funnel: full sprite size, sitting below the name on the left.
    int fdim = SPRITE_SIZE;                       // 32px
    int fy = top + bandH - fdim;                  // anchored to the band bottom
    drawSpriteScaled(spriteFor(v), 1, fy, fdim);

    int tx = fdim + 4;                            // metrics start right of funnel
    dma->setCursor(tx, top + 14);
    dma->setTextColor(C_VALUE); dma->print(v.sog, 1);
    dma->setTextColor(C_DIM);   dma->print("kt");

    dma->setCursor(tx, top + 26);
    dma->setTextColor(C_LABEL); dma->print("CRS");
    dma->setTextColor(C_VALUE); dma->print(v.cog);

    if (v.hasDrft) {
      dma->setCursor(tx, top + 38);
      dma->setTextColor(C_LABEL); dma->print("DR");
      dma->setTextColor(C_VALUE); dma->print(v.drft, 1);
    }
    if (v.dest.length() > 0) {
      dma->setCursor(tx, top + 50);
      dma->setTextColor(C_DIM);   dma->print(">");
      printClipped(v.dest, tx + 6, edge, C_VALUE);
    }
  } else {
    // Split row (32px band): funnel inset to ~28px on the left, two compact
    // text rows to its right.
    int fdim = bandH - 4;                         // 28px in a 32px band
    if (fdim > SPRITE_SIZE) fdim = SPRITE_SIZE;
    int fy = top + (bandH - fdim) / 2;
    drawSpriteScaled(spriteFor(v), 1, fy, fdim);

    int tx = fdim + 4;
    dma->setCursor(tx, top + 1);
    printClipped(v.name, tx, edge - 5, C_NAME);   // leave room for dir glyph
    int dirX = tx + min((int)v.name.length(), (edge - 5 - tx) / 6) * 6 + 2;
    if (dirX < edge - 4) drawDirGlyph(v.dir, dirX, top + 1);

    // Speed + course, no degree sign (course is obviously degrees), clipped.
    String row1 = String(v.sog, 1) + "kt " + String(v.cog);
    dma->setCursor(tx, top + 12);
    printClipped(row1, tx, edge, C_VALUE);

    if (v.dest.length() > 0) {
      dma->setCursor(tx, top + 22);
      printClipped(v.dest, tx, edge, C_DIM);
    }
  }
}

// ---- Screen states ----------------------------------------------------------
void screenSplash() {
  dma->fillScreen(0);
  drawCentered("ST LAWRENCE", H / 2 - 12, C_ACCENT);
  drawCentered("SHIP WALL", H / 2 - 2, C_NAME);
}

void screenStatus(const char* l1, const char* l2) {
  dma->fillScreen(0);
  drawCentered(l1, H / 2 - 8, C_ACCENT);
  if (l2) drawCentered(l2, H / 2 + 4, C_DIM);
}

void screenClosed() {
  dma->fillScreen(0);
  drawCentered("SEAWAY", H / 2 - 16, C_ACCENT);
  drawCentered("CLOSED", H / 2 - 4, C_NAME);
  drawCentered("reopens March", H / 2 + 10, C_DIM);
}

// Decide what to render this tick.
void render() {
  uint32_t now = millis();

  // 1) Lost contact with the Pi? (full-screen, no roster)
  if (lastFrameMs != 0 && now - lastFrameMs > DATA_TIMEOUT_MS) {
    screenStatus("WAITING", "for data");
    return;
  }
  // 2) Winter closure with nothing anywhere. (full-screen)
  if (seawayClosed && vesselCount == 0 && rosterCount == 0) {
    screenClosed();
    return;
  }

  dma->fillScreen(0);

  // --- Left: detail zone for inner-box vessels ---
  if (vesselCount == 0) {
    // Nothing in the close-up reach, but the river may still be busy upstream.
    drawCenteredIn("AMERICAN", DETAIL_W, H / 2 - 12, C_ACCENT);
    drawCenteredIn("NARROWS", DETAIL_W, H / 2 - 2, C_DIM);
    drawCenteredIn("clear", DETAIL_W, H / 2 + 10, C_DIM);
  } else if (vesselCount == 1) {
    drawVesselBand(vessels[0], 0, H, true);
  } else {
    int first = pairIndex;
    int second = (pairIndex + 1) % vesselCount;
    drawVesselBand(vessels[first], 0, H / 2, false);
    for (int x = 0; x < DETAIL_W; x += 2) dma->drawPixel(x, H / 2, C_DIM);
    drawVesselBand(vessels[second], H / 2 + 1, H / 2 - 1, false);
  }

  // --- Right: roster of all big ships in the outer box ---
  drawRoster();
}

// ---- HTTP handler -----------------------------------------------------------
void handleFrame() {
  if (server.method() != HTTP_POST) { server.send(405, "text/plain", "POST only"); return; }
  String body = server.arg("plain");
  StaticJsonDocument<4096> doc;
  if (deserializeJson(doc, body)) { server.send(400, "text/plain", "bad json"); return; }

  targetBright = (uint8_t)(int)(doc["bright"] | 128);
  seawayClosed = doc["closed"] | false;
  dma->setBrightness8(targetBright);

  JsonArray arr = doc["vessels"].as<JsonArray>();
  vesselCount = 0;
  for (JsonObject o : arr) {
    if (vesselCount >= MAX_V) break;
    Vessel& v = vessels[vesselCount];
    v.name = String((const char*)(o["name"] | "?"));
    v.op   = String((const char*)(o["op"]   | "UNKNOWN"));
    v.type = String((const char*)(o["type"] | "VSL"));
    v.dest = String((const char*)(o["dest"] | ""));
    v.sog  = o["sog"] | 0.0;
    v.cog  = o["cog"] | 0;
    if (o["drft"].isNull()) { v.hasDrft = false; v.drft = 0; }
    else { v.hasDrft = true; v.drft = o["drft"] | 0.0; }
    const char* d = o["dir"] | "?";
    v.dir = d[0];
    vesselCount++;
  }

  // Roster (outer-box one-liners).
  JsonArray rarr = doc["roster"].as<JsonArray>();
  rosterCount = 0;
  for (JsonObject o : rarr) {
    if (rosterCount >= MAX_R) break;
    RosterEntry& r = roster[rosterCount];
    r.name = String((const char*)(o["name"] | "?"));
    r.op   = String((const char*)(o["op"]   | "UNKNOWN"));
    const char* d = o["dir"] | "?";
    r.dir = d[0];
    rosterCount++;
  }
  if (pairIndex >= vesselCount) pairIndex = 0;
  lastFrameMs = millis();
  lastSwap = 0;               // force immediate redraw
  server.send(200, "text/plain", "ok");
}

// ---- Setup / loop -----------------------------------------------------------
void setup() {
  Serial.begin(115200);

  HUB75_I2S_CFG mxconfig(PANEL_W, PANEL_H, PANEL_N);
#if !USE_DEFAULT_PINS
  // Classic ESP32 hand-wiring (matches the wiring diagram):
  mxconfig.gpio.r1=25; mxconfig.gpio.g1=26; mxconfig.gpio.b1=27;
  mxconfig.gpio.r2=14; mxconfig.gpio.g2=12; mxconfig.gpio.b2=13;
  mxconfig.gpio.a=23;  mxconfig.gpio.b=19;  mxconfig.gpio.c=5;
  mxconfig.gpio.d=17;  mxconfig.gpio.e=18;
  mxconfig.gpio.clk=16; mxconfig.gpio.lat=4; mxconfig.gpio.oe=15;
#endif
  mxconfig.clkphase = false;
  dma = new MatrixPanel_I2S_DMA(mxconfig);
  dma->begin();
  dma->setBrightness8(targetBright);
  dma->clearScreen();

  W = dma->width();
  H = dma->height();
  DETAIL_W = W - ROSTER_W;

  C_NAME   = dma->color565(255, 200,  40);
  C_LABEL  = dma->color565( 90, 140, 255);
  C_VALUE  = dma->color565(230, 230, 230);
  C_DIM    = dma->color565(110, 110, 110);
  C_DOWN   = dma->color565( 80, 200, 255);   // downbound (toward sea) cyan
  C_UP     = dma->color565(255, 150,  60);   // upbound (toward lakes) orange
  C_ACCENT = dma->color565( 60, 220, 120);

  screenSplash();

  WiFi.mode(WIFI_STA);
  WiFi.begin(WIFI_SSID, WIFI_PASS);
  while (WiFi.status() != WL_CONNECTED) { delay(400); Serial.print("."); }
  Serial.println();
  Serial.print("IP address: ");
  Serial.println(WiFi.localIP());

  server.on("/frame", handleFrame);
  server.begin();

  screenStatus("READY", WiFi.localIP().toString().c_str());
}

void loop() {
  server.handleClient();

  uint32_t now = millis();
  bool needRedraw = (lastSwap == 0);

  // Advance the pair cycle only when showing 2+ vessels.
  if (vesselCount > 2 && now - lastSwap >= PAIR_DWELL_MS) {
    pairIndex = (pairIndex + 2) % vesselCount;
    needRedraw = true;
  } else if (now - lastSwap >= PAIR_DWELL_MS) {
    needRedraw = true;   // periodic refresh for status screens / timeout check
  }

  if (needRedraw) {
    render();
    lastSwap = now;
  }
}
