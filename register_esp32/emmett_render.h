// ============================================================================
//  emmett_render.h  --  "Where's Emmett" map renderer for register_esp32.ino
//  1:1 port of drawEmmett() & helpers from register_panel.py (browser mock).
//  Reads map geometry from emmett_data.h (generated by gen_emmett_header.py).
//
//  Integration (see notes at bottom):
//    #include "emmett_data.h"
//    #include "emmett_render.h"
//    ... then call drawEmmett() in your Emmett rotation slot instead of the
//    text stub. The existing `emmett` struct fields are used as-is.
// ============================================================================
#pragma once
#include <Arduino.h>
#include <math.h>
#include "emmett_data.h"

// ---- These must match the symbols already in register_esp32.ino -------------
//   matrix : Adafruit_Protomatter instance
//   PANEL_W (128), PANEL_H (64)
//   color565(r,g,b) or matrix.color565(...)
//   struct `emmett` with: lat, lon, hasSog, sog, hasCog, cog, hasNav, navstat,
//                         dest (String), name (String), ageSecs (int)
// If your panel object / dims use different names, adjust the 3 lines below.
#ifndef PANEL_W
#define PANEL_W 128
#endif
#ifndef PANEL_H
#define PANEL_H 64
#endif
#define E_PX(x, y, c565) do { int _x=(x),_y=(y); \
  if(_x>=0&&_x<PANEL_W&&_y>=0&&_y<PANEL_H) matrix.drawPixel(_x,_y,(c565)); } while(0)

// Map is drawn at this origin on the 128x64 panel (matches JS E_MAP_OX/OY).
static const int E_MAP_OX = 0;
static const int E_MAP_OY = 7;

// ---- Colors (RGB565), converted from the JS E_COL hex values ----------------
// base #688e32 alt #60842e dark #3c5c22 water #4a8ec8 coast #2c583c
// dot #ff3c28 dothl #ffc878 boxFill #0a0e0c boxEdge #96af8c halo #46553c
// portMark #ffeb78 tHead #6ec878 tMain #d2dccd tDim #96aa96
static inline uint16_t e565(uint8_t r, uint8_t g, uint8_t b) {
  return ((r & 0xF8) << 8) | ((g & 0xFC) << 3) | (b >> 3);
}
static const uint16_t EC_BASE   = e565(0x68,0x8e,0x32);
static const uint16_t EC_ALT    = e565(0x60,0x84,0x2e);
static const uint16_t EC_DARK   = e565(0x3c,0x5c,0x22);
static const uint16_t EC_WATER  = e565(0x4a,0x8e,0xc8);
static const uint16_t EC_COAST  = e565(0x2c,0x58,0x3c);
static const uint16_t EC_DOT    = e565(0xff,0x3c,0x28);
static const uint16_t EC_DOTHL  = e565(0xff,0xc8,0x78);
static const uint16_t EC_BOXF   = e565(0x0a,0x0e,0x0c);
static const uint16_t EC_BOXE   = e565(0x96,0xaf,0x8c);
static const uint16_t EC_HALO   = e565(0x46,0x55,0x3c);
static const uint16_t EC_PORT   = e565(0xff,0xeb,0x78);
static const uint16_t EC_THEAD  = e565(0x6e,0xc8,0x78);
static const uint16_t EC_TMAIN  = e565(0xd2,0xdc,0xcd);
static const uint16_t EC_TDIM   = e565(0x96,0xaa,0x96);
static const uint16_t EC_CHIPE  = e565(0xb4,0xc8,0xaa);  // title chip edge
static const uint16_t EC_CHIPT  = e565(0xdc,0xe6,0xd2);  // title chip text

// ---- 3x5 font, scoped to the Emmett frame (matches JS E_FONT) ---------------
// Each glyph: 5 rows of a 3-bit mask, bit2=left (JS used 1<<(E_GW-1-c)).
struct EGlyphDef { char ch; uint8_t rows[5]; };
static const EGlyphDef E_FONT[] = {
  {'A',{2,5,7,5,5}},{'B',{6,5,6,5,6}},{'C',{3,4,4,4,3}},{'D',{6,5,5,5,6}},
  {'E',{7,4,6,4,7}},{'F',{7,4,6,4,4}},{'G',{3,4,5,5,3}},{'H',{5,5,7,5,5}},
  {'I',{7,2,2,2,7}},{'J',{1,1,1,5,2}},{'K',{5,6,4,6,5}},{'L',{4,4,4,4,7}},
  {'M',{5,7,7,5,5}},{'N',{5,7,7,7,5}},{'O',{2,5,5,5,2}},{'P',{6,5,6,4,4}},
  {'Q',{2,5,5,3,1}},{'R',{6,5,6,6,5}},{'S',{3,4,2,1,6}},{'T',{7,2,2,2,2}},
  {'U',{5,5,5,5,3}},{'V',{5,5,5,2,2}},{'W',{5,5,7,7,5}},{'X',{5,5,2,5,5}},
  {'Y',{5,5,2,2,2}},{'Z',{7,1,2,4,7}},
  {'0',{2,5,5,5,2}},{'1',{2,6,2,2,7}},{'2',{6,1,2,4,7}},{'3',{6,1,2,1,6}},
  {'4',{5,5,7,1,1}},{'5',{7,4,6,1,6}},{'6',{3,4,6,5,2}},{'7',{7,1,2,2,2}},
  {'8',{2,5,2,5,2}},{'9',{2,5,3,1,6}},
  {'.',{0,0,0,0,2}},{'-',{0,0,7,0,0}},{':',{0,2,0,2,0}},{' ',{0,0,0,0,0}},
  {'/',{1,1,2,4,4}},{'?',{6,1,2,0,2}},{'\'',{2,2,0,0,0}},{',',{0,0,0,2,4}},
};
static const int E_GW = 3, E_GADV = 4, E_GH = 5;

static const uint8_t* eGlyphRows(char ch) {
  for (size_t i = 0; i < sizeof(E_FONT)/sizeof(E_FONT[0]); i++)
    if (E_FONT[i].ch == ch) return E_FONT[i].rows;
  // '?' fallback
  for (size_t i = 0; i < sizeof(E_FONT)/sizeof(E_FONT[0]); i++)
    if (E_FONT[i].ch == '?') return E_FONT[i].rows;
  return E_FONT[0].rows;
}
static void eGlyph(char ch, int x, int y, uint16_t col) {
  const uint8_t* g = eGlyphRows(ch);
  for (int r = 0; r < E_GH; r++) {
    uint8_t bits = g[r];
    for (int c = 0; c < E_GW; c++)
      if (bits & (1 << (E_GW - 1 - c))) E_PX(x + c, y + r, col);
  }
}
// maxX==0 means "no clip" (mirrors the JS optional arg)
static int eTxt(const char* s, int x, int y, uint16_t col, int maxX) {
  int gx = x;
  for (const char* p = s; *p; p++) {
    char ch = *p; if (ch >= 'a' && ch <= 'z') ch -= 32;  // toUpperCase
    if (maxX && gx + E_GW > maxX) break;
    eGlyph(ch, gx, y, col);
    gx += E_GADV;
  }
  return gx;
}
static inline int eTxt(const String& s, int x, int y, uint16_t col, int maxX) {
  return eTxt(s.c_str(), x, y, col, maxX);
}

// ---- geometry helpers (match emmett_geo.py / the JS) ------------------------
static void eLL2XY(float lon, float lat, int* ox, int* oy) {
  float fx = (lon - E_LON_MIN) / (E_LON_MAX - E_LON_MIN);
  float fy = (E_LAT_MAX - lat) / (E_LAT_MAX - E_LAT_MIN);
  *ox = (int)lroundf(fx * (E_W - 1));
  *oy = (int)lroundf(fy * (E_H - 1));
}
static float eHaversineMi(float la1, float lo1, float la2, float lo2) {
  const float R = 3958.7613f, rad = (float)M_PI / 180.0f;
  float dp = (la2 - la1) * rad, dl = (lo2 - lo1) * rad;
  float a = sinf(dp/2)*sinf(dp/2)
          + cosf(la1*rad)*cosf(la2*rad)*sinf(dl/2)*sinf(dl/2);
  float s = sqrtf(a); if (s > 1.0f) s = 1.0f;
  return 2 * R * asinf(s);
}

// water bitmap access (1bpp, row-major)
static inline bool eIsWater(int x, int y) {
  if (x < 0 || x >= E_W || y < 0 || y >= E_H) return false;
  uint32_t idx = (uint32_t)y * E_W + x;
  uint8_t byte = pgm_read_byte(&E_WATER_BITS[idx >> 3]);
  return (byte >> (idx & 7)) & 1;
}
// lake id at a water pixel: walk row-major to find its index in E_LAKE_ID.
// (Generator stored ids in sorted (y,x) == row-major order.)
static int eWaterIndex(int x, int y) {
  if (!eIsWater(x, y)) return -1;
  uint32_t target = (uint32_t)y * E_W + x;
  int count = 0;
  for (uint32_t idx = 0; idx < (uint32_t)E_W * E_H; idx++) {
    uint8_t byte = pgm_read_byte(&E_WATER_BITS[idx >> 3]);
    if ((byte >> (idx & 7)) & 1) {
      if (idx == target) return count;
      count++;
    }
  }
  return -1;
}
// Nearest-water lake name, expanding-ring r=0..4 (matches eLakeName in JS).
static const char* eLakeName(float lon, float lat) {
  int wx, wy; eLL2XY(lon, lat, &wx, &wy);
  for (int r = 0; r <= 4; r++) {
    const char* best = nullptr; int bd = 1 << 30;
    for (int dy = -r; dy <= r; dy++)
      for (int dx = -r; dx <= r; dx++) {
        if (max(abs(dx), abs(dy)) != r) continue;
        int wi = eWaterIndex(wx + dx, wy + dy);
        if (wi < 0) continue;
        uint8_t id = pgm_read_byte(&E_LAKE_ID[wi]);
        if (id == 0) continue;                 // 0 == "?"
        int d = dx*dx + dy*dy;
        if (d < bd) { bd = d; best = E_LAKE_NAMES[id]; }
      }
    if (best) return best;
  }
  return "?";
}

// nav label (matches eNavLabel)
static const char* eNavLabel(bool hasNav, int nav, bool hasSog, float sog) {
  static const struct { int code; const char* lbl; } NAV[] = {
    {0,"UNDERWAY"},{1,"ANCHORED"},{2,"NOT UNDER CMD"},{3,"RESTRICTED"},
    {4,"DRAFT LIMITED"},{5,"MOORED"},{6,"AGROUND"},{7,"FISHING"},
    {8,"SAILING"},{15,"UNDEFINED"},
  };
  bool moving = (hasSog && sog > 0.5f);
  const char* label = nullptr;
  if (hasNav) for (auto& n : NAV) if (n.code == nav) { label = n.lbl; break; }
  bool isMooredAnchUndef = label &&
      (!strcmp(label,"MOORED")||!strcmp(label,"ANCHORED")||!strcmp(label,"UNDEFINED"));
  bool isUnderUndef = label &&
      (!strcmp(label,"UNDERWAY")||!strcmp(label,"UNDEFINED"));
  if (moving && (label == nullptr || isMooredAnchUndef)) return "UNDERWAY";
  if (!moving && (label == nullptr || isUnderUndef)) return "STOPPED";
  if (label) return label;
  return moving ? "UNDERWAY" : "STOPPED";
}

// active port: destination keyword match first, else nearest within 60 mi
static int eActivePort(float lat, float lon, const String& dest) {
  if (dest.length()) {
    String up = dest; up.toUpperCase();
    for (int i = 0; i < E_NUM_MARKERS; i++) {
      const EMarker& m = E_MARKERS[i];
      for (int j = 0; j < m.nKw; j++) {
        const char* kw = (const char*)pgm_read_ptr(&m.kw[j]);
        // kw is in PROGMEM; copy to RAM for indexOf
        char buf[24]; strncpy_P(buf, kw, sizeof(buf)); buf[sizeof(buf)-1] = 0;
        if (up.indexOf(buf) >= 0) return i;
      }
    }
  }
  int best = -1; float bd = 1e9f;
  for (int i = 0; i < E_NUM_MARKERS; i++) {
    const EMarker& m = E_MARKERS[i];
    if (m.nKw == 0) continue;                 // only real ports are candidates
    float d = eHaversineMi(lat, lon, m.lat, m.lon);
    if (d < bd) { bd = d; best = i; }
  }
  return (bd <= 60.0f) ? best : -1;
}

// icon draw: 8-neighbour halo of the silhouette, then the cells (matches eDrawIcon)
static void eDrawIcon(int markerIdx, int ax, int ay) {
  const EMarker& m = E_MARKERS[markerIdx];
  if (!m.cells || m.nCells == 0) return;
  int ox = m.ox, oy = m.oy;
  // halo: for each cell, paint its 8-neighbours that are NOT themselves cells
  for (uint16_t i = 0; i < m.nCells; i++) {
    ECell c; memcpy_P(&c, &m.cells[i], sizeof(ECell));
    for (int hx = -1; hx <= 1; hx++)
      for (int hy = -1; hy <= 1; hy++) {
        int nx = c.dx + hx, ny = c.dy + hy;
        bool occupied = false;
        for (uint16_t k = 0; k < m.nCells; k++) {
          ECell o; memcpy_P(&o, &m.cells[k], sizeof(ECell));
          if (o.dx == nx && o.dy == ny) { occupied = true; break; }
        }
        if (!occupied)
          E_PX(E_MAP_OX + ax + ox + nx, E_MAP_OY + ay + oy + ny, EC_HALO);
      }
  }
  for (uint16_t i = 0; i < m.nCells; i++) {
    ECell c; memcpy_P(&c, &m.cells[i], sizeof(ECell));
    E_PX(E_MAP_OX + ax + ox + c.dx, E_MAP_OY + ay + oy + c.dy, c.col);
  }
}

static void eBox(int x, int y, int w, int h, uint16_t fill, uint16_t edge) {
  for (int yy = y; yy < y + h; yy++)
    for (int xx = x; xx < x + w; xx++) {
      bool isEdge = (xx == x || xx == x + w - 1 || yy == y || yy == y + h - 1);
      E_PX(xx, yy, isEdge ? edge : fill);
    }
}

// ===========================================================================
//  drawEmmett() -- the full frame. Mirrors register_panel.py drawEmmett(e).
//  Reads the global `emmett` struct populated from the pushed frame.
// ===========================================================================
void drawEmmett() {
  const float lat = emmett.lat, lon = emmett.lon;

  // 1) green dithered field (deterministic hash, identical to the JS)
  for (int y = 0; y < PANEL_H; y++)
    for (int x = 0; x < PANEL_W; x++) {
      uint32_t r = (((uint32_t)x * 73856093u) ^ ((uint32_t)y * 19349663u));
      if ((r % 83) == 0)            E_PX(x, y, EC_DARK);
      else if (((x + y) & 1))       E_PX(x, y, EC_ALT);
      else                          E_PX(x, y, EC_BASE);
    }

  // 2) water, then coast (water pixel with a non-water 4-neighbour)
  for (int y = 0; y < E_H; y++)
    for (int x = 0; x < E_W; x++)
      if (eIsWater(x, y)) E_PX(E_MAP_OX + x, E_MAP_OY + y, EC_WATER);
  for (int y = 0; y < E_H; y++)
    for (int x = 0; x < E_W; x++) {
      if (!eIsWater(x, y)) continue;
      if (!eIsWater(x+1,y) || !eIsWater(x-1,y) ||
          !eIsWater(x,y+1) || !eIsWater(x,y-1))
        E_PX(E_MAP_OX + x, E_MAP_OY + y, EC_COAST);
    }

  // 3) home icons (always) + one active port icon
  int activePort = eActivePort(lat, lon, emmett.dest);
  for (int i = 0; i < E_NUM_MARKERS; i++) {
    const EMarker& m = E_MARKERS[i];
    bool show = m.isHome || (i == activePort);
    if (!show) continue;
    int ax, ay; eLL2XY(m.lon, m.lat, &ax, &ay);
    eDrawIcon(i, ax, ay);
  }

  // 4) port dots (1px) for every non-home marker
  for (int i = 0; i < E_NUM_MARKERS; i++) {
    const EMarker& m = E_MARKERS[i];
    if (m.isHome) continue;
    int ax, ay; eLL2XY(m.lon, m.lat, &ax, &ay);
    E_PX(E_MAP_OX + ax, E_MAP_OY + ay, EC_PORT);
  }

  // 5) Emmett position dot (if inside the projection window)
  bool inWin = (lon >= E_LON_MIN && lon <= E_LON_MAX &&
                lat >= E_LAT_MIN && lat <= E_LAT_MAX);
  if (inWin) {
    int dx, dy; eLL2XY(lon, lat, &dx, &dy);
    E_PX(E_MAP_OX + dx + 1, E_MAP_OY + dy,     EC_DOTHL);
    E_PX(E_MAP_OX + dx - 1, E_MAP_OY + dy,     EC_DOTHL);
    E_PX(E_MAP_OX + dx,     E_MAP_OY + dy + 1, EC_DOTHL);
    E_PX(E_MAP_OX + dx,     E_MAP_OY + dy - 1, EC_DOTHL);
    E_PX(E_MAP_OX + dx,     E_MAP_OY + dy,     EC_DOT);
  }

  // 6) title chip + EMMETT label (overlaps top-left, matches the mock)
  eBox(0, 0, 29, 7, EC_BOXF, EC_CHIPE);
  eTxt("EMMETT", 3, 1, EC_CHIPT, 0);

  // 7) detail box (top-right): lake / nav / SOG / distance to Traverse City
  const int BX = 62, BY = 0, BW = PANEL_W - BX, BH = 29;
  eBox(BX, BY, BW, BH, EC_BOXF, EC_BOXE);
  const int tx = BX + 3, maxX = PANEL_W - 2;

  const char* lake = eLakeName(lon, lat);
  const char* lakeDisp = (strcmp(lake, "?") != 0) ? lake : "AT SEA";
  const char* nav = eNavLabel(emmett.hasNav, emmett.navstat,
                              emmett.hasSog, emmett.sog);

  char sogDisp[12];
  if (emmett.hasSog) snprintf(sogDisp, sizeof(sogDisp), "%.1f KN", emmett.sog);
  else               snprintf(sogDisp, sizeof(sogDisp), "-- KN");

  float dist = eHaversineMi(lat, lon, E_HOME_LAT, E_HOME_LON);
  char distDisp[12];
  snprintf(distDisp, sizeof(distDisp), "TVC %dMI", (int)lroundf(dist));

  eTxt(lakeDisp, tx, BY + 3,  EC_THEAD, maxX);
  eTxt(nav,      tx, BY + 9,  EC_TMAIN, maxX);
  eTxt(sogDisp,  tx, BY + 15, EC_TDIM,  maxX);
  eTxt(distDisp, tx, BY + 21, EC_TMAIN, maxX);
}

// ============================================================================
//  INTEGRATION into register_esp32/register_esp32.ino
//  --------------------------------------------------------------------------
//  1) Generate the data header on the Pi (from the repo root):
//         .venv/bin/python3 gen_emmett_header.py
//     -> writes register_esp32/emmett_data.h
//
//  2) Drop emmett_render.h into register_esp32/ alongside the .ino.
//
//  3) Near the top of register_esp32.ino, AFTER the `emmett` struct is
//     declared and AFTER `matrix` is defined, add:
//         #include "emmett_render.h"
//     (emmett_render.h pulls in emmett_data.h itself.)
//
//  4) DELETE the old text-stub drawEmmett() in the .ino (the one at ~line 414
//     that calls textAt("WHERE'S EMMETT"...)). This file defines the real one.
//     If you keep both you'll get a duplicate-definition link error -- that's
//     the reminder to remove the stub.
//
//  5) The call site at ~line 511 (`} else if (haveEmmett) { drawEmmett(); }`)
//     needs no change -- same signature, no args.
//
//  PROGMEM / RAM notes:
//    - All map geometry lives in flash (PROGMEM). The S3 has plenty.
//    - eWaterIndex() does a row-major rescan per lake lookup. It's called
//      up to ~41 times per frame (5x5+... ring), each scanning W*H=4608 bits.
//      On the S3 at 240MHz that's trivial, but if you ever see frame jitter,
//      precompute a prefix-count table once in setup().
//    - If your panel object isn't named `matrix` or uses a different pixel
//      call, change the E_PX macro at the top of this file.
// ============================================================================